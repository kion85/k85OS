## sdkconfig.defaults
```kconfig
CONFIG_PARTITION_TABLE_CUSTOM=y
CONFIG_PARTITION_TABLE_CUSTOM_FILENAME="partitions.csv"
CONFIG_SPIRAM_TRY_ALLOCATE_WIFI_LWIP=y

CONFIG_SPIRAM_MALLOC_ALWAYSINTERNAL=4096

CONFIG_ESPTOOLPY_FLASHSIZE_8MB=y

CONFIG_ESPTOOLPY_FLASHSIZE="8MB"
```
