## sdkconfig.defaults
```kconfig
CONFIG_PARTITION_TABLE_CUSTOM=y
CONFIG_PARTITION_TABLE_CUSTOM_FILENAME="partitions.csv"
CONFIG_SPIRAM_TRY_ALLOCATE_WIFI_LWIP=y

CONFIG_SPIRAM_MALLOC_ALWAYSINTERNAL=4096

CONFIG_ESPTOOLPY_FLASHSIZE_8MB=y

CONFIG_ESPTOOLPY_FLASHSIZE="8MB"

CONFIG_SPIRAM_ALLOW_BSS_SEG_EXTERNAL_MEMORY=y

CONFIG_FATFS_LFN_HEAP=y

CONFIG_MBEDTLS_EXTERNAL_MEM_ALLOC=y

CONFIG_FREERTOS_GENERATE_RUN_TIME_STATS=y
CONFIG_FREERTOS_RUN_TIME_COUNTER_TYPE_U32=y
```
